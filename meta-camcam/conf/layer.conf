## meta-camcam/conf/layer.conf
```bitbake
# We have a conf and classes directory, add to BBPATH
BBPATH .= ":${LAYERDIR}"

# We have recipes-* directories, add to BBFILES
BBFILES += "${LAYERDIR}/recipes-*/*/*.bb \
            ${LAYERDIR}/recipes-*/*/*.bbappend"

BBFILE_COLLECTIONS += "meta-camcam"
BBFILE_PATTERN_meta-camcam = "^${LAYERDIR}/"
BBFILE_PRIORITY_meta-camcam = "10"

LAYERDEPENDS_meta-camcam = "core meta-python"
LAYERSERIES_COMPAT_meta-camcam = "warrior dunfell"
```
